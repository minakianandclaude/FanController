## main/Kconfig.projbuild
```kconfig
menu "VanFan Controller"

    menu "WiFi Configuration"
        config VANFAN_WIFI_SSID
            string "WiFi SSID"
            default "YOUR_WIFI_SSID"
            help
                SSID of your WiFi network.

        config VANFAN_WIFI_PASSWORD
            string "WiFi Password"
            default "YOUR_WIFI_PASSWORD"
            help
                Password of your WiFi network.
    endmenu

    menu "Network"
        config VANFAN_MDNS_HOSTNAME
            string "mDNS Hostname"
            default "vanfan"
            help
                mDNS hostname (accessible as <hostname>.local).
    endmenu

    menu "BTS7960 Pin Assignments"
        config VANFAN_PIN_RPWM
            int "RPWM GPIO (forward PWM)"
            default 5

        config VANFAN_PIN_LPWM
            int "LPWM GPIO (reverse PWM)"
            default 6

        config VANFAN_PIN_R_EN
            int "R_EN GPIO (right enable)"
            default 7

        config VANFAN_PIN_L_EN
            int "L_EN GPIO (left enable)"
            default 15

        config VANFAN_PIN_R_IS
            int "R_IS GPIO (right current sense, ADC)"
            default 4

        config VANFAN_PIN_L_IS
            int "L_IS GPIO (left current sense, ADC)"
            default 3
    endmenu

    menu "Button Pin Assignments"
        config VANFAN_PIN_BTN_SPEED
            int "Speed button GPIO"
            default 9

        config VANFAN_PIN_BTN_DIRECTION
            int "Direction button GPIO"
            default 10
    endmenu

    menu "Status LED"
        config VANFAN_PIN_STATUS_LED
            int "Status LED GPIO (WS2812B)"
            default 46
    endmenu

    menu "LED Light Pin Assignments"
        config VANFAN_PIN_LED_ZONE1
            int "LED Zone 1 PWM GPIO"
            default 11

        config VANFAN_PIN_LED_ZONE2
            int "LED Zone 2 PWM GPIO"
            default 12

        config VANFAN_PIN_LED_ZONE3
            int "LED Zone 3 PWM GPIO"
            default 13
    endmenu

    menu "Light Button"
        config VANFAN_PIN_BTN_LIGHT
            int "Light button GPIO"
            default 14
    endmenu

endmenu
```

## sdkconfig.defaults
```kconfig
# Flash
CONFIG_ESPTOOLPY_FLASHSIZE_4MB=y
CONFIG_ESPTOOLPY_FLASHMODE_QIO=y

# Partition table
CONFIG_PARTITION_TABLE_CUSTOM=y
CONFIG_PARTITION_TABLE_CUSTOM_FILENAME="partitions.csv"

# FreeRTOS
CONFIG_FREERTOS_HZ=1000
CONFIG_ESP_MAIN_TASK_STACK_SIZE=8192
CONFIG_FREERTOS_TIMER_TASK_STACK_DEPTH=4096

# Console via USB Serial/JTAG (native USB on ESP32-S3)
CONFIG_ESP_CONSOLE_USB_SERIAL_JTAG=y

# Brownout detection
CONFIG_ESP_BROWNOUT_DET=y

# HTTP server
CONFIG_HTTPD_MAX_REQ_HDR_LEN=1024
CONFIG_HTTPD_MAX_URI_LEN=512

# WiFi credentials (replaced at build time by Docker)
CONFIG_VANFAN_WIFI_SSID="YOUR_WIFI_SSID"
CONFIG_VANFAN_WIFI_PASSWORD="YOUR_WIFI_PASSWORD"

# mDNS hostname
CONFIG_VANFAN_MDNS_HOSTNAME="vanfan"

# Bluetooth (NimBLE for BLE provisioning)
CONFIG_BT_ENABLED=y
CONFIG_BT_NIMBLE_ENABLED=y
CONFIG_BT_NIMBLE_MEM_ALLOC_MODE_INTERNAL=y
```
